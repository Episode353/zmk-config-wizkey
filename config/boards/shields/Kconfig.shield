## config/boards/shields/Kconfig.shield
```kconfig
config SHIELD_WIZKEY_LEFT
    def_bool $(shields_list_contains,wizkey_left)

config SHIELD_WIZKEY_RIGHT
    def_bool $(shields_list_contains,wizkey_right)
```
