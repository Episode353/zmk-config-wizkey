## config/boards/shields/caldera/Kconfig.defconfig
```kconfig
if SHIELD_CALDERA_LEFT

config ZMK_KEYBOARD_NAME
    default "Caldera"

endif

if SHIELD_CALDERA_RIGHT

config ZMK_KEYBOARD_NAME
    default "Caldera"

endif

if SHIELD_CALDERA_LEFT || SHIELD_CALDERA_RIGHT

config ZMK_SPLIT
    default y

config ZMK_SPLIT_BLE_ROLE_CENTRAL
    default y if SHIELD_CALDERA_LEFT

config ZMK_SPLIT_BLE_ROLE_PERIPHERAL
    default y if SHIELD_CALDERA_RIGHT

config ZMK_SPLIT_PERIPHERAL_HID_KEYBOARD
    default y

config ZMK_SPLIT_PERIPHERAL_HID_CONSUMER
    default y

config ZMK_USB
    default y

endif
```

## config/boards/shields/wizkey/Kconfig.defconfig
```kconfig
if SHIELD_WIZKEY_LEFT

config ZMK_KEYBOARD_NAME
    default "Wizkey Left"

endif

if SHIELD_WIZKEY_RIGHT

config ZMK_KEYBOARD_NAME
    default "Wizkey Right"

endif
```
